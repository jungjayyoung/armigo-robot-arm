#include "lcd_font.h"
#include "ili9341.h"

// 8x16 표준 ASCII 폰트 비트맵 데이터 (0x20 Space ~ 0x7E '~')
static const uint8_t font8x16[] = {
    0x00,0x00,0x00,0x00,0x00,0x00,0x00,0x00,0x00,0x00,0x00,0x00,0x00,0x00,0x00,0x00, // Space
    0x00,0x00,0x18,0x3C,0x3C,0x3C,0x18,0x18,0x18,0x00,0x18,0x18,0x00,0x00,0x00,0x00, // !
    0x00,0x66,0x66,0x66,0x24,0x00,0x00,0x00,0x00,0x00,0x00,0x00,0x00,0x00,0x00,0x00, // "
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    0x00,0x00,0x00,0x00,0x10,0x6C,0xC6,0x44,0x00,0x00,0x00,0x00,0x00,0x00,0x00,0x00  // ~ (물결표 추가 완료)
};

// Draw one glyph as a continuous RGB565 window. The previous implementation
// opened a new ILI9341 address window for every pixel, which made a single
// status-screen refresh take several seconds on the shared SPI bus.
void LCD_PutChar(uint16_t x, uint16_t y, char ch, uint16_t color, uint16_t bg_color, uint8_t scale) {
    uint8_t row_pixels[8U * 4U * 2U];

    if (ch < ' ' || ch > '~') {
        ch = ' ';
    }
    if ((scale == 0U) || (scale > 4U)) {
        return;
    }
    if (((uint32_t)x + (8U * scale) > ILI9341_WIDTH) ||
        ((uint32_t)y + (16U * scale) > ILI9341_HEIGHT)) {
        return;
    }

    uint32_t offset = (uint32_t)(ch - 32) * 16;
    ILI9341_SetAddressWindow(x, y,
                            (uint16_t)(x + (8U * scale) - 1U),
                            (uint16_t)(y + (16U * scale) - 1U));
    LCD_DC_DATA();

    for (uint8_t i = 0; i < 16; i++) {
        uint8_t b = font8x16[offset + i];
        for (uint8_t j = 0; j < 8; j++) {
            uint16_t pixel_color = (b & (0x80U >> j)) ? color : bg_color;
            for (uint8_t sx = 0U; sx < scale; ++sx) {
                uint16_t index = (uint16_t)(((j * scale) + sx) * 2U);
                row_pixels[index] = (uint8_t)(pixel_color >> 8U);
                row_pixels[index + 1U] = (uint8_t)pixel_color;
            }
        }
        for (uint8_t sy = 0U; sy < scale; ++sy) {
            (void)HAL_SPI_Transmit(&hspi1, row_pixels,
                                   (uint16_t)(8U * scale * 2U),
                                   HAL_MAX_DELAY);
        }
    }
}

// 문자열 전체 출력 함수
void LCD_PutString(uint16_t x, uint16_t y, const char *str, uint16_t color, uint16_t bg_color, uint8_t scale) {
    while (*str) {
        if (x + (8 * scale) >= 320) {
            x = 0;
            y += (16 * scale);
        }
        LCD_PutChar(x, y, *str, color, bg_color, scale);
        x += (8 * scale);
        str++;
    }
}
